/* Раскладка памяти userspace-программы VOID (Веха 19.1).
 *
 * Линкуется на фиксированную базу 0x4000_0000 — начало региона VPN[2]=1, отведённого ядром под
 * адресное пространство процесса (см. `proc::USER_REGION_START`, kernel/src/proc.rs). Стек
 * процессу даёт ядро как обычно (растёт вниз от 0x8000_0000) — здесь его не резервируем.
 *
 * Три PT_LOAD-сегмента с РАЗНЫМИ правами (флаги ELF: R=4, W=2, X=1) — ядерный загрузчик
 * (kernel/src/elf.rs) читает `p_flags` каждого сегмента и маппит его страницы буквально этими
 * правами. ALIGN(4K) перед каждым сегментом обязателен: если бы два сегмента с разными правами
 * делили одну 4-КиБ страницу, загрузчик замаппил бы её дважды с разными флагами (последний
 * побеждает — тихая порча прав). W^X: ни один сегмент не несёт W и X одновременно.
 *
 * `_start` — обычная `extern "C" fn` (см. src/main.rs), НЕ ассемблерный трамплин: в отличие от
 * ядра (которое OpenSBI прыгает по фиксированному физическому адресу первым байтом образа), сюда
 * приходят через `e_entry` из ELF-заголовка — адрес символа `_start` неважен, важно, что ENTRY()
 * его туда положит. Стек (sp) и аргумент (a0) уже выставлены ядром в trap-кадре до входа. */
OUTPUT_ARCH(riscv)
ENTRY(_start)

BASE_ADDRESS = 0x40000000;

PHDRS
{
    text   PT_LOAD FLAGS(5); /* R+X — код, никогда W */
    rodata PT_LOAD FLAGS(4); /* R   — константы, никогда W и никогда X */
    data   PT_LOAD FLAGS(6); /* R+W — данные+bss, никогда X (W^X) */
}

SECTIONS
{
    . = BASE_ADDRESS;

    .text : ALIGN(4K) {
        *(.text .text.*)
    } :text

    . = ALIGN(4K);
    .rodata : {
        *(.rodata .rodata.*)
        *(.srodata .srodata.*)
    } :rodata

    . = ALIGN(4K);
    .data : {
        *(.data .data.*)
        *(.sdata .sdata.*)
    } :data

    .bss : ALIGN(8) {
        _bss_start = .;
        *(.sbss .sbss.*)
        *(.bss .bss.*)
        *(COMMON)
        _bss_end = .;
    } :data

    . = ALIGN(4K);
    _end = .;

    /DISCARD/ : { *(.eh_frame) *(.note .note.*) *(.comment) }
}
